## drivers/platform/xiaomi/Kconfig
```kconfig
# Xiaomi configuration options

config MACH_XIAOMI
	bool "Xiaomi device"
	depends on ARCH_QCOM
	help
	  Support for Xiaomi products

config MACH_XIAOMI_SM8150
	bool "Xiaomi SM8150"
	depends on ARCH_QCOM
	select MACH_XIAOMI
	help
	  Support for Xiaomi SM8150 devices

config MACH_XIAOMI_VAYU
	bool "Xiaomi vayu board"
	default y
	select MACH_XIAOMI_SM8150
	help
	  Support for POCO X3 Pro
```
